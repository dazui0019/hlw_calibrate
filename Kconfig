## Kconfig
```kconfig
mainmenu "RT-Thread Configuration"

config BSP_DIR
    string
    option env="BSP_ROOT"
    default "."

config RTT_DIR
    string
    option env="RTT_ROOT"
    default "./middleware/rt-thread"

config PKGS_DIR
    string
    option env="PKGS_ROOT"
    default "packages"

source "$RTT_DIR/Kconfig"
source "$PKGS_DIR/Kconfig"
source "./middleware/rt-thread/bsp/gd32/arm/libraries/Kconfig"
source "board/Kconfig"
source "applications/Kconfig"
```

## applications/Kconfig
```kconfig
menu "Software Config"

config BSP_USING_SEGGER_RTT
    bool
    default y

config BSP_USING_FSM
    bool
    default y

config BSP_USING_EVENT_RECORDER
    bool "Enable Event Record"
    default n

config BSP_USING_METER
    bool "Enable Meter"
    default n
    select BSP_USING_CD4051
    select BSP_USING_HLW8032
endmenu
```

## defconfig
```kconfig
CONFIG_RT_CONSOLE_DEVICE_NAME="uart0"
# CONFIG_RT_USING_DFS_DEVFS is not set
CONFIG_RT_USING_ULOG=y
```
